/* Autogenerated by mlir-tblgen; don't manually edit */

#ifdef GEN_PASS_DECL
// Generate declarations for all passes.
#define GEN_PASS_DECL_VERIFYCLUSTERINGPASS
#undef GEN_PASS_DECL
#endif // GEN_PASS_DECL

//===----------------------------------------------------------------------===//
// VerifyClusteringPass
//===----------------------------------------------------------------------===//
#ifdef GEN_PASS_DECL_VERIFYCLUSTERINGPASS
#undef GEN_PASS_DECL_VERIFYCLUSTERINGPASS
#endif // GEN_PASS_DECL_VERIFYCLUSTERINGPASS
#ifdef GEN_PASS_DEF_VERIFYCLUSTERINGPASS
namespace impl {

template <typename DerivedT>
class VerifyClusteringPassBase : public ::mlir::OperationPass<mlir::func::FuncOp> {
public:
  using Base = VerifyClusteringPassBase;

  VerifyClusteringPassBase() : ::mlir::OperationPass<mlir::func::FuncOp>(::mlir::TypeID::get<DerivedT>()) {}
  VerifyClusteringPassBase(const VerifyClusteringPassBase &other) : ::mlir::OperationPass<mlir::func::FuncOp>(other) {}

  /// Returns the command-line argument attached to this pass.
  static constexpr ::llvm::StringLiteral getArgumentName() {
    return ::llvm::StringLiteral("verify-clustering-pass");
  }
  ::llvm::StringRef getArgument() const override { return "verify-clustering-pass"; }

  ::llvm::StringRef getDescription() const override { return "Verify that the Bridge output is correct and errors if verification fails."; }

  /// Returns the derived pass name.
  static constexpr ::llvm::StringLiteral getPassName() {
    return ::llvm::StringLiteral("VerifyClusteringPass");
  }
  ::llvm::StringRef getName() const override { return "VerifyClusteringPass"; }

  /// Support isa/dyn_cast functionality for the derived pass class.
  static bool classof(const ::mlir::Pass *pass) {
    return pass->getTypeID() == ::mlir::TypeID::get<DerivedT>();
  }

  /// A clone method to create a copy of this pass.
  std::unique_ptr<::mlir::Pass> clonePass() const override {
    return std::make_unique<DerivedT>(*static_cast<const DerivedT *>(this));
  }

  /// Return the dialect that must be loaded in the context before this pass.
  void getDependentDialects(::mlir::DialectRegistry &registry) const override {
    
  }

  /// Explicitly declare the TypeID for this class. We declare an explicit private
  /// instantiation because Pass classes should only be visible by the current
  /// library.
  MLIR_DEFINE_EXPLICIT_INTERNAL_INLINE_TYPE_ID(VerifyClusteringPassBase<DerivedT>)

protected:
private:
};
} // namespace impl
#undef GEN_PASS_DEF_VERIFYCLUSTERINGPASS
#endif // GEN_PASS_DEF_VERIFYCLUSTERINGPASS
#ifdef GEN_PASS_REGISTRATION

//===----------------------------------------------------------------------===//
// VerifyClusteringPass Registration
//===----------------------------------------------------------------------===//

inline void registerVerifyClusteringPass() {
  ::mlir::registerPass([]() -> std::unique_ptr<::mlir::Pass> {
    return tensorflow::tf2xla::internal::CreateVerifyClusteringPass();
  });
}

// Old registration code, kept for temporary backwards compatibility.
inline void registerVerifyClusteringPassPass() {
  ::mlir::registerPass([]() -> std::unique_ptr<::mlir::Pass> {
    return tensorflow::tf2xla::internal::CreateVerifyClusteringPass();
  });
}

//===----------------------------------------------------------------------===//
// TFXLABridge Registration
//===----------------------------------------------------------------------===//

inline void registerTFXLABridgePasses() {
  registerVerifyClusteringPass();
}
#undef GEN_PASS_REGISTRATION
#endif // GEN_PASS_REGISTRATION
// Deprecated. Please use the new per-pass macros.
#ifdef GEN_PASS_CLASSES

template <typename DerivedT>
class VerifyClusteringPassBase : public ::mlir::OperationPass<mlir::func::FuncOp> {
public:
  using Base = VerifyClusteringPassBase;

  VerifyClusteringPassBase() : ::mlir::OperationPass<mlir::func::FuncOp>(::mlir::TypeID::get<DerivedT>()) {}
  VerifyClusteringPassBase(const VerifyClusteringPassBase &other) : ::mlir::OperationPass<mlir::func::FuncOp>(other) {}

  /// Returns the command-line argument attached to this pass.
  static constexpr ::llvm::StringLiteral getArgumentName() {
    return ::llvm::StringLiteral("verify-clustering-pass");
  }
  ::llvm::StringRef getArgument() const override { return "verify-clustering-pass"; }

  ::llvm::StringRef getDescription() const override { return "Verify that the Bridge output is correct and errors if verification fails."; }

  /// Returns the derived pass name.
  static constexpr ::llvm::StringLiteral getPassName() {
    return ::llvm::StringLiteral("VerifyClusteringPass");
  }
  ::llvm::StringRef getName() const override { return "VerifyClusteringPass"; }

  /// Support isa/dyn_cast functionality for the derived pass class.
  static bool classof(const ::mlir::Pass *pass) {
    return pass->getTypeID() == ::mlir::TypeID::get<DerivedT>();
  }

  /// A clone method to create a copy of this pass.
  std::unique_ptr<::mlir::Pass> clonePass() const override {
    return std::make_unique<DerivedT>(*static_cast<const DerivedT *>(this));
  }

  /// Return the dialect that must be loaded in the context before this pass.
  void getDependentDialects(::mlir::DialectRegistry &registry) const override {
    
  }

  /// Explicitly declare the TypeID for this class. We declare an explicit private
  /// instantiation because Pass classes should only be visible by the current
  /// library.
  MLIR_DEFINE_EXPLICIT_INTERNAL_INLINE_TYPE_ID(VerifyClusteringPassBase<DerivedT>)

protected:
};
#undef GEN_PASS_CLASSES
#endif // GEN_PASS_CLASSES
